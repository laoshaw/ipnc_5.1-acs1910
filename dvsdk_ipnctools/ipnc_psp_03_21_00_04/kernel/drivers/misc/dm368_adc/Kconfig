## dvsdk_ipnctools/ipnc_psp_03_21_00_04/kernel/drivers/misc/dm368_adc/Kconfig
```kconfig
#
# DM365ADC devices
#

menu "DM368ADC Devices"

config DM368_ADC
	tristate "DM368 ADC support"
	default y
	---help---
	This option enables basic support for the DM365
	ADC Devices.

	If you want to use the DM365 ADC Devices Y.
	Otherwise say N.

endmenu
```
